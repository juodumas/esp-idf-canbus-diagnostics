## sdkconfig.defaults
```kconfig
; Route the console (printf/ESP_LOG/getchar) over USB-Serial-JTAG so a single
; USB cable to the ESP32-C3-DevKitM-1 gives both log output and CLI input.
CONFIG_ESP_CONSOLE_USB_SERIAL_JTAG=y
CONFIG_ESP_CONSOLE_SECONDARY_NONE=y
CONFIG_ESP_MAIN_TASK_STACK_SIZE=4096
```
